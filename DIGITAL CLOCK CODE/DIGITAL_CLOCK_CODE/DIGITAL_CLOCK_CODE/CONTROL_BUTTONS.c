/*
 * CONTROL_BUTTONS.c
 *
 * Created: 10/5/2020 10:13:04 AM
 *  Author: ideapad510
 */ 
#include "CONTROL_BUTTONS.h"
#include "CLOCK_MANAGE.h"
#include "CAPACITIVE_TOUCH.h"
#include "DIGITAL_7_SEG.h"
#include "timer0.h"
#include "TIMER1.h"
volatile unsigned char TIMER0_COUNTER_FOR_SHOWING=0;
volatile APP_STATES_DT APP_STATE=WORKING;
CAPACITIVE_BUTTON_POINTER CAP1;
unsigned short BUFFERSEC=0,BUFFERMIN=0,BUFFERHOUR=0,BUFFERSHOW=0;
void CONTROL_BUTTONS_INTILIZE()
{
	gpio_inputconfg(CONTROL_DDR,CONTROL_INMOD,PULLUP_mod,SECBUTTONS);
	gpio_inputconfg(CONTROL_DDR,CONTROL_INMOD,PULLUP_mod,MINBUTTONS);
	gpio_inputconfg(CONTROL_DDR,CONTROL_INMOD,PULLUP_mod,HOURBUTTONS);
	gpio_inputconfg(CONTROL_DDR,CONTROL_INMOD,PULLUP_mod,SETBUTTON);		
	CAP1=NEW_CAPACITIVE_BUTTON(CAP_BUTTON_OUT_DDR_ADDRESS,CAP_BUTTON_OUT_OUT_ADDRESS,CAP_BUTTON_OUT_OUTMOD_ADDRESS,CAP_BUTTON_OUT_PIN,CAP_BUTTON_IN_DDR_ADDRESS,CAP_BUTTON_IN_IN_ADDRESS,CAP_BUTTON_IN_OUT_ADDRESS,CAP_BUTTON_IN_INMOD_ADDRESS,CAP_BUTTON_IN_PIN,1150);
	
}
#define BUFFERMAX 500
unsigned char CONTROL_CAPTURE()
{
	
	
	
	
	if (BUFFERSEC==0)
	{
		if (isbitclear(*CONTROL_IN,SECBUTTONS))
		{
			TIMER1_DISABLE();
			TIMER1_SET_COUNTER(0);
			DIG_STOP_SHOW_SEGMENTS();
			DIG_START_SHOW_SEGMENTS();
			SEC_INCREMENT();
			APPLY_CLOCK();
			BUFFERSEC=BUFFERMAX;
			APP_STATE=SETTING;
		}
	}
	else
	{
		BUFFERSEC--;
	}
	if (BUFFERMIN==0)
	{
		if (isbitclear(*CONTROL_IN,MINBUTTONS))
		{
			
			
			TIMER1_DISABLE();
			TIMER1_SET_COUNTER(0);
			DIG_STOP_SHOW_SEGMENTS();
			DIG_START_SHOW_SEGMENTS();
			MIN_INCREMENT();
			APPLY_CLOCK();
			BUFFERMIN=BUFFERMAX;
			APP_STATE=SETTING;
		}
	}
	else
	{
		BUFFERMIN--;
	}
	if (BUFFERHOUR==0)
	{
		if (isbitclear(*CONTROL_IN,HOURBUTTONS))
		{
			
			TIMER1_DISABLE();
			TIMER1_SET_COUNTER(0);
			DIG_STOP_SHOW_SEGMENTS();
			DIG_START_SHOW_SEGMENTS();
			HOUR_INCREMENT();
			APPLY_CLOCK();
			BUFFERHOUR=BUFFERMAX;
			APP_STATE=SETTING;
		}
	}
	else
	{
		BUFFERHOUR--;
	}
	
	if(APP_STATE!=SETTING)
	{
			if (BUFFERSHOW==0)
			{
				if (CHECK_ALL_CAPACITIVES())
				{
					BUFFERSHOW=BUFFERMAX;
					DIG_START_SHOW_SEGMENTS();
					TIMER0_COUNTER_FOR_SHOWING=0;
					TIMER0_COUNT_RESET();
					TIMER0_ENABLE(T0_TIMER_1024,OVER_FLOW_INT_ENABLE);
				}
			}
			else
			{
				BUFFERSHOW--;
			}
	}
	else
	{
			if (isbitclear(*CONTROL_IN,SETBUTTON))
			{
				TIMER1_ENABLE(T1_OCA1_DISCONNECT,T1_OCB1_DISCONNECT,T1_CTC_OCR1A,T1_TIMER_1024,15624,0,DISABLE_TIMER1_INT,DISABLE_TIMER1_INT,ENABLE_TIMER1_INT,DISABLE_TIMER1_INT);
				DIG_START_SHOW_SEGMENTS();
				TIMER0_COUNTER_FOR_SHOWING=0;
				TIMER0_COUNT_RESET();
				TIMER0_ENABLE(T0_TIMER_1024,OVER_FLOW_INT_ENABLE);
				APP_STATE=WORKING;
			}
	}
	
	
	
	
	return 0;
}
