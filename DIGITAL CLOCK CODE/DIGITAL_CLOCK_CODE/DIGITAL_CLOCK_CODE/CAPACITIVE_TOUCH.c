/*
 * CAPACITIVE_TOUCH.c
 *
 * Created: 10/3/2020 12:48:09 PM
 *  Author: ideapad510
 */ 
#include "CAPACITIVE_TOUCH.h"

CAPACITIVE_TOUCH_BUTTON_DATATYPE CAPACITIVE_TOUCH_BUTTONS_ARRAY[NUMBER_OF_SENSORS];
unsigned char NUMBER_OF_DECLARED_BUTTONS=0;

CAPACITIVE_TOUCH_BUTTON_DATATYPE* NEW_CAPACITIVE_BUTTON(volatile uint8 * NEWPORT_DDR_ADDRESS_OUT, volatile uint8 * NEWPORT_OUT_ADDRESS_OUT, volatile uint8 * NEWPORT_OUTMOD_ADDRESS_OUT, uint8 NEWPINOUT, volatile uint8 * NEWPORT_DDR_ADDRESS_IN, volatile uint8 * NEWPORT_IN_ADDRESS_IN,volatile uint8 * NEWPORT_OUT_ADDRESS_IN, volatile uint8 * NEWPORT_INMOD_ADDRESS_IN, uint8 NEWPININ,unsigned long NEWTHRESH)
{
	if(NUMBER_OF_DECLARED_BUTTONS<NUMBER_OF_SENSORS)
	{
		gpio_outputconfg(NEWPORT_DDR_ADDRESS_OUT,NEWPORT_OUTMOD_ADDRESS_OUT,OUTPASS,NEWPINOUT);
		gpio_inputconfg	(NEWPORT_DDR_ADDRESS_IN,NEWPORT_INMOD_ADDRESS_IN,FLOAT_mod,NEWPININ);
		CAPACITIVE_TOUCH_BUTTONS_ARRAY[NUMBER_OF_DECLARED_BUTTONS].PININ=NEWPININ;
		CAPACITIVE_TOUCH_BUTTONS_ARRAY[NUMBER_OF_DECLARED_BUTTONS].PINOUT=NEWPINOUT;
		CAPACITIVE_TOUCH_BUTTONS_ARRAY[NUMBER_OF_DECLARED_BUTTONS].PORT_OUT_ADDRESS_OUT=NEWPORT_OUT_ADDRESS_OUT;
		CAPACITIVE_TOUCH_BUTTONS_ARRAY[NUMBER_OF_DECLARED_BUTTONS].PORT_IN_ADDRESS_IN=NEWPORT_IN_ADDRESS_IN;
		CAPACITIVE_TOUCH_BUTTONS_ARRAY[NUMBER_OF_DECLARED_BUTTONS].PORT_DDR_ADDRESS_IN=NEWPORT_DDR_ADDRESS_IN;
		CAPACITIVE_TOUCH_BUTTONS_ARRAY[NUMBER_OF_DECLARED_BUTTONS].PORT_OUT_ADDRESS_IN=NEWPORT_OUT_ADDRESS_IN;
		CAPACITIVE_TOUCH_BUTTONS_ARRAY[NUMBER_OF_DECLARED_BUTTONS].THRESH=NEWTHRESH;
		CAPACITIVE_TOUCH_BUTTONS_ARRAY[NUMBER_OF_DECLARED_BUTTONS].STATES=0;
		clearbit(*NEWPORT_OUT_ADDRESS_OUT,NEWPINOUT);
		NUMBER_OF_DECLARED_BUTTONS++;
		return &CAPACITIVE_TOUCH_BUTTONS_ARRAY[NUMBER_OF_DECLARED_BUTTONS-1];
	}
	else
	{
		return 0;
	}
}

uint8 CHECK_ALL_CAPACITIVES()
{
	unsigned char NUMBER_OF_TOUCHED_BUTTONS=0;
	unsigned char COUNTER=0;
	for (COUNTER=0;COUNTER<NUMBER_OF_DECLARED_BUTTONS;++COUNTER)
	{
		NUMBER_OF_TOUCHED_BUTTONS+=1*READ_CAPACITIVE(&CAPACITIVE_TOUCH_BUTTONS_ARRAY[COUNTER] );
	}
	return NUMBER_OF_TOUCHED_BUTTONS;
}
unsigned long counter=0;
uint8 READ_CAPACITIVE(CAPACITIVE_TOUCH_BUTTON_DATATYPE* CAP)
{
	counter=0;
	while (isbitset(*(CAP->PORT_IN_ADDRESS_IN),CAP->PININ)){_delay_us(5);}
	setbit(*(CAP->PORT_OUT_ADDRESS_OUT),CAP->PINOUT);
	while (counter<0xffffff)
	{
		if (isbitset(*(CAP->PORT_IN_ADDRESS_IN),CAP->PININ))
		{
			break;
		}
		counter++;
	}
	clearbit(*(CAP->PORT_OUT_ADDRESS_OUT),CAP->PINOUT);
	_delay_us(5);
	setbit(*(CAP->PORT_DDR_ADDRESS_IN),CAP->PININ);
	clearbit(*(CAP->PORT_OUT_ADDRESS_IN),CAP->PININ);
	_delay_us(5);
	clearbit(*(CAP->PORT_DDR_ADDRESS_IN),CAP->PININ);
/*
	if (counter>50)
	{unsigned char  the_return[8];
		USART_SEND_ARRAY(the_return,inttostring(the_return,counter));
		
	USART_SEND_str("TOUCH DETECTED\n");
	}*/
	
	
	if((CAP->THRESH)>counter)
	{
		CAP->STATES=0;
		return 0;
	}
	else
	{
		CAP->STATES=1;
		return 1;
	}
}





												
